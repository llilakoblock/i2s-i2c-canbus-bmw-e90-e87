## sdkconfig.defaults
```kconfig
# ESP32 SAA7706H Attack Configuration

# CPU Configuration
CONFIG_ESP32_DEFAULT_CPU_FREQ_240=y
CONFIG_FREERTOS_HZ=1000

# Flash Configuration
CONFIG_ESPTOOLPY_FLASHSIZE_4MB=y
CONFIG_ESPTOOLPY_FLASHSIZE="4MB"
CONFIG_ESPTOOLPY_FLASHMODE_DIO=y

# I2C Configuration
CONFIG_I2C_ISR_IRAM_SAFE=y

# I2S Configuration
CONFIG_I2S_ISR_IRAM_SAFE=y

# Log Level
CONFIG_LOG_DEFAULT_LEVEL_INFO=y
CONFIG_LOG_MAXIMUM_LEVEL_DEBUG=y
```
